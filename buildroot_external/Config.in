## buildroot_external/package/gadget-init-scripts/Config.in
```kconfig
config BR2_PACKAGE_GADGET_INIT_SCRIPTS
	bool "gadget-init-scripts"
	select BR2_PACKAGE_SKELETON
	select BR2_PACKAGE_DNSMASQ
	select BR2_PACKAGE_DNSMASQ_DHCP

if BR2_PACKAGE_GADGET_INIT_SCRIPTS

config BR2_PACKAGE_GADGET_INIT_SCRIPTS_USB_GADGET
	bool "USB Gadget Init"
	select BR2_PACKAGE_SKELETON
	select BR2_PACKAGE_DNSMASQ
	select BR2_PACKAGE_DNSMASQ_DHCP
	help
	  This option enables usb gadget serial and ethernet on boot

endif
```

## configs/popstick_nand_defconfig
```kconfig
BR2_arm=y
BR2_TOOLCHAIN_BUILDROOT_MUSL=y
BR2_KERNEL_HEADERS_5_17=y
BR2_LINUX_KERNEL=y
BR2_LINUX_KERNEL_CUSTOM_TARBALL=y
BR2_LINUX_KERNEL_CUSTOM_TARBALL_LOCATION="https://cdn.kernel.org/pub/linux/kernel/v6.x/linux-6.0.1.tar.xz"
BR2_LINUX_KERNEL_PATCH="board/popcorncomputer/popstick/patches/linux"
BR2_LINUX_KERNEL_USE_CUSTOM_CONFIG=y
BR2_LINUX_KERNEL_CUSTOM_CONFIG_FILE="board/popcorncomputer/popstick/linux-config"
BR2_LINUX_KERNEL_ZSTD=y
BR2_LINUX_KERNEL_DTS_SUPPORT=y
BR2_LINUX_KERNEL_INTREE_DTS_NAME="suniv-f1c200s-popstick-v1.1"
BR2_LINUX_KERNEL_INSTALL_TARGET=y
BR2_PACKAGE_MTD=y
BR2_PACKAGE_MTD_MKFSUBIFS=y
# BR2_TARGET_ROOTFS_TAR is not set
BR2_TARGET_GENERIC_HOSTNAME="popstick"
BR2_TARGET_GENERIC_ISSUE="Welcome to your USB Computer!"
BR2_TARGET_ROOTFS_UBI=y
BR2_TARGET_ROOTFS_UBI_SUBSIZE=2048
BR2_TARGET_ROOTFS_UBI_USE_CUSTOM_CONFIG=y
BR2_TARGET_ROOTFS_UBI_CUSTOM_CONFIG_FILE="board/popcorncomputer/popstick/ubinize.cfg"
BR2_TARGET_ROOTFS_UBIFS_LEBSIZE=0x1f000
BR2_TARGET_ROOTFS_UBIFS_MAXLEBCNT=990
BR2_TARGET_UBOOT=y
BR2_TARGET_UBOOT_BUILD_SYSTEM_KCONFIG=y
BR2_TARGET_UBOOT_CUSTOM_GIT=y
BR2_TARGET_UBOOT_CUSTOM_REPO_URL="git@github.com:PopcornComputer/Popstick-uboot.git"
BR2_TARGET_UBOOT_CUSTOM_REPO_VERSION="popstick-wip"
BR2_TARGET_UBOOT_PATCH="board/popcorncomputer/popstick/patches/u-boot"
BR2_TARGET_UBOOT_BOARD_DEFCONFIG="popstick"
BR2_TARGET_UBOOT_NEEDS_DTC=y
BR2_TARGET_UBOOT_NEEDS_PYTHON3=y
# BR2_TARGET_UBOOT_FORMAT_BIN is not set
BR2_TARGET_UBOOT_FORMAT_IMG=y
BR2_TARGET_UBOOT_SPL=y
BR2_TARGET_UBOOT_SPL_NAME="spl/sunxi-spl.bin"
BR2_TARGET_ROOTFS_UBIFS_OPTS="-F"

# USB Ethernet & SSH
BR2_PACKAGE_CONNMAN=y
#BR2_PACKAGE_DROPBEAR=y
BR2_PACKAGE_LIBCURL=y
BR2_PACKAGE_LIBCURL_CURL=y
BR2_PACKAGE_LIGHTTPD=y
BR2_PACKAGE_LIGHTTPD_OPENSSL=y
BR2_PACKAGE_LIGHTTPD_PCRE=y
BR2_PACKAGE_OPENSSH=y
BR2_PACKAGE_OPENSSH_CLIENT=y
BR2_PACKAGE_OPENSSH_SERVER=y
BR2_PACKAGE_OPENSSH_KEY_UTILS=y
BR2_PACKAGE_BUSYBOX_SHOW_OTHERS=y
BR2_PACKAGE_ZSH=y
BR2_PACKAGE_SUDO=y
BR2_SYSTEM_BIN_SH_ZSH=y

BR2_ROOTFS_USERS_TABLES="${BR2_EXTERNAL}/board/popcorncomputer/popstick/makeusers.txt"
BR2_PACKAGE_GADGET_INIT_SCRIPTS=y
BR2_PACKAGE_GADGET_INIT_SCRIPTS_USB_GADGET=y
BR2_PACKAGE_POPSTICK_DOCS=y
```
